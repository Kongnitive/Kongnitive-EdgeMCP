## main/Kconfig.projbuild
```kconfig
menu "MCP Server Configuration"

config MCP_WIFI_SSID
    string "WiFi SSID"
    default "myssid"
    help
        SSID (network name) for the MCP server to connect to.

config MCP_WIFI_PASSWORD
    string "WiFi Password"
    default "mypassword"
    help
        WiFi password (WPA or WPA2) for the MCP server to use.

config MCP_MAX_MESSAGE_SIZE
    int "Maximum JSON-RPC message size"
    default 4096
    help
        Maximum size of incoming JSON-RPC messages in bytes

config MCP_MAX_TOOL_RESULT_SIZE
    int "Maximum tool result size"
    default 2048
    help
        Maximum size of tool result text in bytes

config BLINK_GPIO
    int "Blink GPIO number"
    range 0 48
    default 2 if IDF_TARGET_ESP32
    default 8 if IDF_TARGET_ESP32C3
    default 8 if IDF_TARGET_ESP32S2
    default 8 if IDF_TARGET_ESP32S3
    default 8
    help
        GPIO number (IOxx) to blink on and off or the RMT signal for the addressable LED.
        Some GPIOs are used for other purposes (flash connections, etc.) and cannot be used to blink.

menu "Logging"

    config MCP_LOG_BUFFER_SIZE
        int "Log ring buffer size (bytes)"
        default 4096
        range 1024 16384
        help
            Size of the log capture ring buffer in bytes

endmenu

menu "OTA Updates"

    config MCP_OTA_URL
        string "Default OTA firmware URL"
        default "http://YOUR_HOST:8080/wss_server.bin"
        help
            Default HTTP URL for OTA firmware binary (used by local dev server)

endmenu

endmenu
```

## sdkconfig.defaults
```kconfig
CONFIG_ESP_HTTPS_SERVER_ENABLE=y
CONFIG_HTTPD_WS_SUPPORT=y

# Flash size configuration
CONFIG_ESPTOOLPY_FLASHSIZE_8MB=y
CONFIG_ESPTOOLPY_FLASHSIZE="8MB"

# PSRAM configuration (XIAO ESP32S3)
CONFIG_SPIRAM=y
CONFIG_ESP32S3_SPIRAM_SUPPORT=y
# XIAO ESP32S3 commonly uses ESP32-S3R8 (octal PSRAM in-package)
CONFIG_SPIRAM_MODE_OCT=y
# Keep booting even when PSRAM init fails (helps mixed board variants)
CONFIG_SPIRAM_IGNORE_NOTFOUND=y

# Custom OTA partition table
CONFIG_PARTITION_TABLE_CUSTOM=y
CONFIG_PARTITION_TABLE_CUSTOM_FILENAME="partitions_ota.csv"
CONFIG_PARTITION_TABLE_FILENAME="partitions_ota.csv"

# Enable app rollback
CONFIG_BOOTLOADER_APP_ROLLBACK_ENABLE=y

# WiFi Configuration
CONFIG_MCP_WIFI_SSID="YOUR_WIFI_SSID"
CONFIG_MCP_WIFI_PASSWORD="YOUR_WIFI_PASSWORD"

# MCP Server Configuration
CONFIG_BLINK_GPIO=2
CONFIG_MCP_MAX_MESSAGE_SIZE=4096
CONFIG_MCP_MAX_TOOL_RESULT_SIZE=2048

# Logging and OTA Configuration
CONFIG_MCP_LOG_BUFFER_SIZE=4096
CONFIG_MCP_OTA_URL="http://YOUR_HOST:8080/wss_server.bin"

# SPIFFS Configuration
CONFIG_SPIFFS_MAX_PARTITIONS=1
```
